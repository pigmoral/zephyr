## samples/subsys/ipc/openamp_rsc_table/boards/milkv_duo_cv1800b_c906_1.conf
```kconfig
CONFIG_IPM_MBOX=y
CONFIG_OPENAMP_WITH_DCACHE=y

CONFIG_LOG=y
CONFIG_LOG_BACKEND_UART=y
CONFIG_LOG_DEFAULT_LEVEL=3
CONFIG_LOG_MODE_MINIMAL=y
```
